## configs/byteg_nano_uboot_defconfig
```kconfig
# Copyright (C) 2006 Microchip Technology Inc. and its subsidiaries
#
# SPDX-License-Identifier: MIT

CONFIG_SAMA5D2=y
CONFIG_DEBUG=y
CONFIG_DDR_SET_BY_DEVICE=y
CONFIG_SDCARD=y
CONFIG_JUMP_ADDR="0x23f00000"
# CONFIG_ENTER_NWD is not set
# CONFIG_SDHC_8BIT_SUPPORT is not set
CONFIG_BOARD_QUIRK_SAMA5D2_SIP=y
```
